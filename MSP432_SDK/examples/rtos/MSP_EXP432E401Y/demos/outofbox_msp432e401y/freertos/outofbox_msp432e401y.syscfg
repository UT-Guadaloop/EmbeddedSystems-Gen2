/*
 * Copyright (c) 2018, Texas Instruments Incorporated
 * All rights reserved.
 *
 * Redistribution and use in source and binary forms, with or without
 * modification, are permitted provided that the following conditions
 * are met:
 *
 * *  Redistributions of source code must retain the above copyright
 *    notice, this list of conditions and the following disclaimer.
 *
 * *  Redistributions in binary form must reproduce the above copyright
 *    notice, this list of conditions and the following disclaimer in the
 *    documentation and/or other materials provided with the distribution.
 *
 * *  Neither the name of Texas Instruments Incorporated nor the names of
 *    its contributors may be used to endorse or promote products derived
 *    from this software without specific prior written permission.
 *
 * THIS SOFTWARE IS PROVIDED BY THE COPYRIGHT HOLDERS AND CONTRIBUTORS "AS IS"
 * AND ANY EXPRESS OR IMPLIED WARRANTIES, INCLUDING, BUT NOT LIMITED TO,
 * THE IMPLIED WARRANTIES OF MERCHANTABILITY AND FITNESS FOR A PARTICULAR
 * PURPOSE ARE DISCLAIMED. IN NO EVENT SHALL THE COPYRIGHT OWNER OR
 * CONTRIBUTORS BE LIABLE FOR ANY DIRECT, INDIRECT, INCIDENTAL, SPECIAL,
 * EXEMPLARY, OR CONSEQUENTIAL DAMAGES (INCLUDING, BUT NOT LIMITED TO,
 * PROCUREMENT OF SUBSTITUTE GOODS OR SERVICES; LOSS OF USE, DATA, OR PROFITS;
 * OR BUSINESS INTERRUPTION) HOWEVER CAUSED AND ON ANY THEORY OF LIABILITY,
 * WHETHER IN CONTRACT, STRICT LIABILITY, OR TORT (INCLUDING NEGLIGENCE OR
 * OTHERWISE) ARISING IN ANY WAY OUT OF THE USE OF THIS SOFTWARE,
 * EVEN IF ADVISED OF THE POSSIBILITY OF SUCH DAMAGE.
 */
// @cliArgs --board /ti/boards/MSP_EXP432E401Y

/*
 *  outofbox_msp432e401y.syscfg
 */

/* ======== RTOS ======== */
var RTOS = scripting.addModule("/ti/drivers/RTOS");
RTOS.name = "FreeRTOS";

/* ======== GPIO ======== */
var GPIO = scripting.addModule("/ti/drivers/GPIO");

var gpio0 = GPIO.addInstance();
gpio0.$hardware = system.deviceData.board.components.BUTTON0;
gpio0.$name = "CONFIG_GPIO_BUTTON0";
gpio0.interruptTrigger = "Falling Edge";
gpio0.pull = "Pull Up";

var gpio1 = GPIO.addInstance();
gpio1.$hardware = system.deviceData.board.components.BUTTON1;
gpio1.$name = "CONFIG_GPIO_BUTTON1";
gpio1.interruptTrigger = "Falling Edge";
gpio1.pull = "Pull Up";

var gpio2 = GPIO.addInstance();
gpio2.$hardware = system.deviceData.board.components.LED0;
gpio2.$name = "CONFIG_GPIO_LED0";

var gpio3 = GPIO.addInstance();
gpio3.$hardware = system.deviceData.board.components.LED1;
gpio3.$name = "CONFIG_GPIO_LED1";

/* ======== UART ======== */
var UART = scripting.addModule("/ti/drivers/UART");
var uart = UART.addInstance();
uart.$hardware = system.deviceData.board.components.XDS110UART;
uart.$name = "CONFIG_UART0";

/* ======== SlNet Interfaces ======== */
var SlNet = scripting.addModule("/ti/net/SlNet");
var interface1 = SlNet.addInstance();
interface1.id = 2;
interface1.enableSecureSocks = false;

/* ======== General ======== */
var General = scripting.addModule("/ti/ndk/General");
General.ipv6 = false;
General.ndkThreadStkSize = 2048;
General.lowPriTaskDefStkSize = 2048;
General.normPriTaskDefStkSize = 2048;
General.highPriTaskDefStkSize = 2048;
General.networkIPAddrHook = "netIPAddrHook";
/* --- TCP --- */
General.tcpTxBufSize = 1024;
General.tcpRxBufSize = 1024;
General.tcpRxBufLimit = 2048;
/* --- UDP --- */
General.udpRxBufSize = 2048;

/* --- NIMU --- */
var eth0 = scripting.addModule("/ti/ndk/NIMU").addInstance();
eth0.dhcpcServReportFxn = "serviceReport";
eth0.emac.$name = "CONFIG_EMAC_0";
eth0.emac.$hardware = system.deviceData.board.components.ETHERNET_LEDS;
eth0.emac.emac.$name = "MyETHERNET1";
eth0.emac.emac.$assign = "ETHERNET0";
eth0.emac.emac.led0Pin.$assign = "PF0";
eth0.emac.emac.led1Pin.$assign = "PF4";
