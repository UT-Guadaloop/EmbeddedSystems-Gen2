// These arguments were used when this file was generated. They will be automatically applied on subsequent loads 
// via the GUI or CLI invocations. Run CLI with '--help' for additional information on how to override these arguments.
// @versions {"data":"2019020517","timestamp":"2019020517","tool":"1.0.655","templates":"2019020517"}
// @cliArgs --board /ti/boards/MSP_EXP432E401Y

var Display = scripting.addModule("/ti/display/Display");
var Display1 = Display.addInstance();
var Power = scripting.addModule("/ti/drivers/Power");
var Board = scripting.addModule("/ti/drivers/Board");
var DriverLib = scripting.addModule("/ti/devices/DriverLib");
var Settings = scripting.addModule("/ti/usblib/Settings");
var Settings1 = Settings.addInstance();
var LED = scripting.addModule("/ti/drivers/apps/LED");
var LED1 = LED.addInstance();
var LED2 = LED.addInstance();
// Name - The C/C++ identifier used in applications as the index parameter passed to Display runtime APIs
Display1.$name = "CONFIG_Display_0";
// Use Hardware - Select the hardware to use, or 'None' to use available header pins
Display1.$hardware = system.deviceData.board.components.XDS110UART;
// Name - The C/C++ identifier used in applications as the index parameter passed to UART runtime APIs
Display1.uart.$name = "CONFIG_UART_0";
// Name
Display1.uart.uart.$name = "MyUART1";
// Name
Settings1.$name = "CONFIG_USB_0";
// Use Hardware - Select the hardware to use, or 'None' to use available header pins
Settings1.$hardware = system.deviceData.board.components.MICROUSB;
// MSC Host Class Driver - Enable/disable Host Class Driver to communicate with MSC device.
Settings1.hasMscHCD = true;
// Name
Settings1.usb.$name = "MyUSB1";
// Name
Settings1.stringDescriptor.$name = "usb_string0";
// Product Name - Product name string that appears upon enumeration.
Settings1.stringDescriptor.productName = "Virtual COM Port";
// Interface Description - Interface description string.
Settings1.stringDescriptor.interfaceDescription = "ACM Control Interface";
// Configuration Description - Configuration description string.
Settings1.stringDescriptor.configurationDescription = "Self Powered Configuration";
// Name
Settings1.configuration.$name = "usb_configuration0";
// Max Power (mA) - Max Power Consumption of Device in mA.
Settings1.configuration.maxPower = "0";
// Device Class
Settings1.configuration.deviceClass = "CDC";
// Name
Settings1.configuration.cdc.$name = "serialDevice";
// Transmit Event Handler Function - Callback function for events related to data transmit channel.
Settings1.configuration.cdc.txBufferHandler = "cbTxHandler";
// Receive Event Handler Function - Callback function for events related to data receive channel.
Settings1.configuration.cdc.rxBufferHandler = "cbRxHandler";
// Control Event Handler Function - Callback function for events related to asynchronous control operations.
Settings1.configuration.cdc.controlHandler = "cbSerialHandler";
// Name - The C/C++ identifier used in applications as the index parameter passed to LED runtime APIs
LED1.$name = "CONFIG_LED_0";
// Use Hardware - Select the hardware to use, or 'None' to use available header pins
LED1.$hardware = system.deviceData.board.components.D1;
// Mode - Select the GPIO mode
LED1.gpioPin.mode = "Output";
// Callback Function - The name of the callback function called when this GPIO pin triggers an interrupt, or 'NULL' if it's specified at runtime
LED1.gpioPin.callbackFunction = "";
// Name - The C/C++ identifier used in applications as the index parameter passed to LED runtime APIs
LED2.$name = "CONFIG_LED_1";
// Use Hardware - Select the hardware to use, or 'None' to use available header pins
LED2.$hardware = system.deviceData.board.components.D2;
// Mode - Select the GPIO mode
LED2.gpioPin.mode = "Output";
// Callback Function - The name of the callback function called when this GPIO pin triggers an interrupt, or 'NULL' if it's specified at runtime
LED2.gpioPin.callbackFunction = "";
// Suggest solution
Display1.uart.uart.$suggestSolution = "UART0";
// Suggest solution
Display1.uart.uart.txPin.$suggestSolution = "34";
// Suggest solution
Display1.uart.uart.rxPin.$suggestSolution = "33";
// Suggest solution
Settings1.usb.$suggestSolution = "USB0";
// Suggest solution
Settings1.usb.dmPin.$suggestSolution = "93";
// Suggest solution
Settings1.usb.dpPin.$suggestSolution = "94";
// Suggest solution
Settings1.usb.idPin.$suggestSolution = "95";
// Suggest solution
Settings1.usb.vbusPin.$suggestSolution = "96";
// Suggest solution
LED1.gpioPin.gpioPin.$suggestSolution = "108";
// Suggest solution
LED2.gpioPin.gpioPin.$suggestSolution = "107";
