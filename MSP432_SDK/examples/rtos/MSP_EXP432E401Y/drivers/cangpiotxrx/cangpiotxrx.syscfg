/*
 * Copyright (c) 2019, Texas Instruments Incorporated
 * All rights reserved.
 *
 * Redistribution and use in source and binary forms, with or without
 * modification, are permitted provided that the following conditions
 * are met:
 *
 * *  Redistributions of source code must retain the above copyright
 *    notice, this list of conditions and the following disclaimer.
 *
 * *  Redistributions in binary form must reproduce the above copyright
 *    notice, this list of conditions and the following disclaimer in the
 *    documentation and/or other materials provided with the distribution.
 *
 * *  Neither the name of Texas Instruments Incorporated nor the names of
 *    its contributors may be used to endorse or promote products derived
 *    from this software without specific prior written permission.
 *
 * THIS SOFTWARE IS PROVIDED BY THE COPYRIGHT HOLDERS AND CONTRIBUTORS "AS IS"
 * AND ANY EXPRESS OR IMPLIED WARRANTIES, INCLUDING, BUT NOT LIMITED TO,
 * THE IMPLIED WARRANTIES OF MERCHANTABILITY AND FITNESS FOR A PARTICULAR
 * PURPOSE ARE DISCLAIMED. IN NO EVENT SHALL THE COPYRIGHT OWNER OR
 * CONTRIBUTORS BE LIABLE FOR ANY DIRECT, INDIRECT, INCIDENTAL, SPECIAL,
 * EXEMPLARY, OR CONSEQUENTIAL DAMAGES (INCLUDING, BUT NOT LIMITED TO,
 * PROCUREMENT OF SUBSTITUTE GOODS OR SERVICES; LOSS OF USE, DATA, OR PROFITS;
 * OR BUSINESS INTERRUPTION) HOWEVER CAUSED AND ON ANY THEORY OF LIABILITY,
 * WHETHER IN CONTRACT, STRICT LIABILITY, OR TORT (INCLUDING NEGLIGENCE OR
 * OTHERWISE) ARISING IN ANY WAY OUT OF THE USE OF THIS SOFTWARE,
 * EVEN IF ADVISED OF THE POSSIBILITY OF SUCH DAMAGE.
 */
// @cliArgs --board /ti/boards/MSP_EXP432E401Y

/*
 *  cangpiotxrx.syscfg
 */

/* ======== Display ======== */
var Display = scripting.addModule("/ti/display/Display");

var display = Display.addInstance();
display.$name = "Display_Type_UART";
display.uart.uart.$assign = "UART2";
display.uart.uart.txPin.$assign = "expansion.38"; // PD5
display.uart.uart.rxPin.$assign = "expansion.40"; // PD4

/* ======== CAN ======== */
var CAN = scripting.addModule("/ti/drivers/CAN");

var CAN0 = CAN.addInstance();
CAN0.$name = "CONFIG_CAN_0";
CAN0.can.$assign = "CAN0";
CAN0.can.rxPin.$assign = "expansion.74"; // PA0
CAN0.can.txPin.$assign = "expansion.76"; // PA1

/* ======== GPIO ======== */
var GPIO = scripting.addModule("/ti/drivers/GPIO");

var GPIO1 = GPIO.addInstance();
GPIO1.$hardware = system.deviceData.board.components.USR_SW1;
GPIO1.$name = "CONFIG_GPIO_BUTTON_1";

var GPIO2 = GPIO.addInstance();
GPIO2.$hardware = system.deviceData.board.components.USR_SW2;
GPIO2.$name = "CONFIG_GPIO_BUTTON_2";

var GPIO3 = GPIO.addInstance();
GPIO3.$hardware = system.deviceData.board.components.D1;
GPIO3.$name = "CONFIG_GPIO_LED_0";

var GPIO4 = GPIO.addInstance();
GPIO4.$hardware = system.deviceData.board.components.D2;
GPIO4.$name = "CONFIG_GPIO_LED_1";
