/*
 * Copyright (c) 2018-2020, Texas Instruments Incorporated - http://www.ti.com
 * All rights reserved.
 *
 * Redistribution and use in source and binary forms, with or without
 * modification, are permitted provided that the following conditions
 * are met:
 *
 * *  Redistributions of source code must retain the above copyright
 *    notice, this list of conditions and the following disclaimer.
 *
 * *  Redistributions in binary form must reproduce the above copyright
 *    notice, this list of conditions and the following disclaimer in the
 *    documentation and/or other materials provided with the distribution.
 *
 * *  Neither the name of Texas Instruments Incorporated nor the names of
 *    its contributors may be used to endorse or promote products derived
 *    from this software without specific prior written permission.
 *
 * THIS SOFTWARE IS PROVIDED BY THE COPYRIGHT HOLDERS AND CONTRIBUTORS "AS IS"
 * AND ANY EXPRESS OR IMPLIED WARRANTIES, INCLUDING, BUT NOT LIMITED TO,
 * THE IMPLIED WARRANTIES OF MERCHANTABILITY AND FITNESS FOR A PARTICULAR
 * PURPOSE ARE DISCLAIMED. IN NO EVENT SHALL THE COPYRIGHT OWNER OR
 * CONTRIBUTORS BE LIABLE FOR ANY DIRECT, INDIRECT, INCIDENTAL, SPECIAL,
 * EXEMPLARY, OR CONSEQUENTIAL DAMAGES (INCLUDING, BUT NOT LIMITED TO,
 * PROCUREMENT OF SUBSTITUTE GOODS OR SERVICES; LOSS OF USE, DATA, OR PROFITS;
 * OR BUSINESS INTERRUPTION) HOWEVER CAUSED AND ON ANY THEORY OF LIABILITY,
 * WHETHER IN CONTRACT, STRICT LIABILITY, OR TORT (INCLUDING NEGLIGENCE OR
 * OTHERWISE) ARISING IN ANY WAY OUT OF THE USE OF THIS SOFTWARE,
 * EVEN IF ADVISED OF THE POSSIBILITY OF SUCH DAMAGE.
 */
// @cliArgs --board /ti/boards/MSP_EXP432E401Y

/*
 *  tcpechotls.syscfg
 */

/* ======== RTOS ======== */
var RTOS = scripting.addModule("/ti/drivers/RTOS");
RTOS.name = "FreeRTOS";

/* ======== Display ======== */
var Display = scripting.addModule("/ti/display/Display");
var display = Display.addInstance();
display.$hardware = system.deviceData.board.components.XDS110UART;

/* ======== SlNet Interfaces ======== */
var SlNet = scripting.addModule("/ti/net/SlNet");
var interface1 = SlNet.addInstance();
interface1.id = 2;
interface1.SECOBJ.create(3);
interface1.SECOBJ[0].$name = "DummyCA";
interface1.SECOBJ[0].secObjVariable = "cliCAPem";
interface1.SECOBJ[0].secObjVariableSize = "cliCAPemLen";
interface1.SECOBJ[1].$name = "DummyTrustedCert";
interface1.SECOBJ[1].secObjVariable = "srvCertPem";
interface1.SECOBJ[1].secObjVariableSize = "srvCertPemLen";
interface1.SECOBJ[2].$name = "DummyKey";
interface1.SECOBJ[2].secObjType = "SLNETIF_SEC_OBJ_TYPE_RSA_PRIVATE_KEY";
interface1.SECOBJ[2].secObjVariable = "srvKeyPem";
interface1.SECOBJ[2].secObjVariable = "srvKeyPem";
interface1.SECOBJ[2].secObjVariableSize = "srvKeyPemLen";

/* ======== General ======== */
var General = scripting.addModule("/ti/ndk/General");
General.ipv6 = false;
General.ndkThreadStkSize = 2048;
General.lowPriTaskDefStkSize = 2048;
General.normPriTaskDefStkSize = 2048;
General.highPriTaskDefStkSize = 2048;
General.networkIPAddrHook = "netIPAddrHook";
/* --- TCP --- */
General.tcpTxBufSize = 1024;
General.tcpRxBufSize = 1024;
General.tcpRxBufLimit = 2048;
/* --- UDP --- */
General.udpRxBufSize = 2048;

/* ======== NIMU ======== */
var eth0 = scripting.addModule("/ti/ndk/NIMU").addInstance();
eth0.dhcpcServReportFxn = "serviceReport";
eth0.emac.$name = "CONFIG_EMAC_0";
